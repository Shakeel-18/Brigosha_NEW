/*@!Encoding:1252*/
includes
{
  
}

variables
{
  message 0x200 Rxmsg1 = {dlc=8};
  int datasize;
  int recbytes;
}

on start
{
  write("Rx:started");
   datasize = 0;
  recbytes = 0;
}
  
on message 0x100
{
  if((this.byte(0) & 0xF0) == 0x10)  //get the higher nibble of byte 0
  {
    write("Rx:Message from Tx node");
    write("this.byte(0) = %X",this.byte(0));  //commented
    datasize=(this.byte(0) & 0xF0)<<8 | this.byte(1); //to get the lower nibble of byte 0 and total byte 1 (data length)
    write("Rx:datasize=%X",datasize);
      write("Recieved first 6 bytes of data");
    Rxmsg1.byte(0)=0x30;
      Rxmsg1.byte(1)=0x00;
      Rxmsg1.byte(2)=0x00;
    output(Rxmsg1);
  }
}